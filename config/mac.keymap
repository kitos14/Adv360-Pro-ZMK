#include <behaviors.dtsi>

/ {
    behaviors {
        j_tab: j_tab {
            compatible = "zmk,behavior-mod-morph";
            label = "J_OR_TAB";
            #binding-cells = <0>;
            bindings = <&kp J>, <&shift_tab>;
            mods = <(MOD_RALT)>;
            keep-mods = <(MOD_RALT)>;
        };
    };
};